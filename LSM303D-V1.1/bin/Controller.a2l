MEASUREMENT_ADDRESS_TYPE 16 DEVICE_TYPE 1
/******************************************************************************
* ASAP2 file: Controller.a2l
* Real-Time Workshop code generation for Simulink model "Controller.mdl".
* Model Version : 1.0.1
* Real-Time Workshop version : 6.5 (R2006b) 03-Aug-2006
* C source code generated on : Mon Jun 15 15:15:09 2015
* (add additional file header information here)
******************************************************************************/ ASAP2_VERSION 1 31
/* Version 1.31 */
/begin PROJECT ProjectName "Project Comment Goes Here"
/begin HEADER "Header Comments go here" /end HEADER
/begin MODULE ModuleName "Module Comment Goes Here"
/begin MOD_PAR "MOD PAR Comment Goes Here" /end MOD_PAR
/begin MOD_COMMON "Mod Common Comment Here" BYTE_ORDER MSB_FIRST /end MOD_COMMON
/begin RECORD_LAYOUT Scalar_BOOLEAN FNC_VALUES 1 UBYTE COLUMN_DIR DIRECT /end RECORD_LAYOUT
/begin RECORD_LAYOUT Scalar_UBYTE FNC_VALUES 1 UBYTE COLUMN_DIR DIRECT /end RECORD_LAYOUT
/begin RECORD_LAYOUT Scalar_BYTE FNC_VALUES 1 SBYTE COLUMN_DIR DIRECT /end RECORD_LAYOUT
/begin RECORD_LAYOUT Scalar_UWORD FNC_VALUES 1 UWORD COLUMN_DIR DIRECT /end RECORD_LAYOUT
/begin RECORD_LAYOUT Scalar_SWORD FNC_VALUES 1 SWORD COLUMN_DIR DIRECT /end RECORD_LAYOUT
/begin RECORD_LAYOUT Scalar_ULONG FNC_VALUES 1 ULONG COLUMN_DIR DIRECT /end RECORD_LAYOUT
/begin RECORD_LAYOUT Scalar_LONG FNC_VALUES 1 SLONG COLUMN_DIR DIRECT /end RECORD_LAYOUT
/begin RECORD_LAYOUT Scalar_FLOAT32_IEEE FNC_VALUES 1 FLOAT32_IEEE COLUMN_DIR DIRECT /end RECORD_LAYOUT
/begin RECORD_LAYOUT Scalar_FLOAT64_IEEE FNC_VALUES 1 FLOAT64_IEEE COLUMN_DIR DIRECT /end RECORD_LAYOUT
/begin RECORD_LAYOUT Lookup1D_BYTE FNC_VALUES 1 SBYTE COLUMN_DIR DIRECT /end RECORD_LAYOUT
/begin RECORD_LAYOUT Lookup1D_X_BYTE AXIS_PTS_X 1 SBYTE INDEX_INCR DIRECT /end RECORD_LAYOUT
/begin RECORD_LAYOUT Lookup1D_UBYTE FNC_VALUES 1 UBYTE COLUMN_DIR DIRECT /end RECORD_LAYOUT
/begin RECORD_LAYOUT Lookup1D_X_UBYTE AXIS_PTS_X 1 UBYTE INDEX_INCR DIRECT /end RECORD_LAYOUT
/begin RECORD_LAYOUT Lookup1D_UWORD FNC_VALUES 1 UWORD COLUMN_DIR DIRECT /end RECORD_LAYOUT
/begin RECORD_LAYOUT Lookup1D_X_UWORD AXIS_PTS_X 1 UWORD INDEX_INCR DIRECT /end RECORD_LAYOUT
/begin RECORD_LAYOUT Lookup1D_WORD FNC_VALUES 1 SWORD COLUMN_DIR DIRECT /end RECORD_LAYOUT
/begin RECORD_LAYOUT Lookup1D_X_WORD AXIS_PTS_X 1 SWORD INDEX_INCR DIRECT /end RECORD_LAYOUT
/begin RECORD_LAYOUT Lookup1D_ULONG FNC_VALUES 1 ULONG COLUMN_DIR DIRECT /end RECORD_LAYOUT
/begin RECORD_LAYOUT Lookup1D_X_ULONG AXIS_PTS_X 1 ULONG INDEX_INCR DIRECT /end RECORD_LAYOUT
/begin RECORD_LAYOUT Lookup1D_SLONG FNC_VALUES 1 SLONG COLUMN_DIR DIRECT /end RECORD_LAYOUT
/begin RECORD_LAYOUT Lookup1D_X_LONG AXIS_PTS_X 1 SLONG INDEX_INCR DIRECT /end RECORD_LAYOUT
/begin RECORD_LAYOUT Lookup1D_FLOAT32_IEEE FNC_VALUES 1 FLOAT32_IEEE COLUMN_DIR DIRECT /end RECORD_LAYOUT
/begin RECORD_LAYOUT Lookup1D_X_FLOAT32_IEEE AXIS_PTS_X 1 FLOAT32_IEEE INDEX_INCR DIRECT /end RECORD_LAYOUT
/begin RECORD_LAYOUT Lookup1D_FLOAT64_IEEE FNC_VALUES 1 FLOAT64_IEEE COLUMN_DIR DIRECT /end RECORD_LAYOUT
/begin RECORD_LAYOUT Lookup1D_X_FLOAT64_IEEE AXIS_PTS_X 1 FLOAT64_IEEE INDEX_INCR DIRECT /end RECORD_LAYOUT
/begin RECORD_LAYOUT Lookup2D_UBYTE FNC_VALUES 1 UBYTE COLUMN_DIR DIRECT /end RECORD_LAYOUT
/begin RECORD_LAYOUT Lookup2D_X_UBYTE AXIS_PTS_X 1 UBYTE INDEX_INCR DIRECT /end RECORD_LAYOUT
/begin RECORD_LAYOUT Lookup2D_BYTE FNC_VALUES 1 SBYTE COLUMN_DIR DIRECT /end RECORD_LAYOUT
/begin RECORD_LAYOUT Lookup2D_X_BYTE AXIS_PTS_X 1 SBYTE INDEX_INCR DIRECT /end RECORD_LAYOUT
/begin RECORD_LAYOUT Lookup2D_UWORD FNC_VALUES 1 UWORD COLUMN_DIR DIRECT /end RECORD_LAYOUT
/begin RECORD_LAYOUT Lookup2D_X_UWORD AXIS_PTS_X 1 UWORD INDEX_INCR DIRECT /end RECORD_LAYOUT
/begin RECORD_LAYOUT Lookup2D_WORD FNC_VALUES 1 SWORD COLUMN_DIR DIRECT /end RECORD_LAYOUT
/begin RECORD_LAYOUT Lookup2D_X_WORD AXIS_PTS_X 1 SWORD INDEX_INCR DIRECT /end RECORD_LAYOUT
/begin RECORD_LAYOUT Lookup2D_ULONG FNC_VALUES 1 ULONG COLUMN_DIR DIRECT /end RECORD_LAYOUT
/begin RECORD_LAYOUT Lookup2D_X_ULONG AXIS_PTS_X 1 ULONG INDEX_INCR DIRECT /end RECORD_LAYOUT
/begin RECORD_LAYOUT Lookup2D_LONG FNC_VALUES 1 SLONG COLUMN_DIR DIRECT /end RECORD_LAYOUT
/begin RECORD_LAYOUT Lookup2D_X_LONG AXIS_PTS_X 1 SLONG INDEX_INCR DIRECT /end RECORD_LAYOUT
/begin RECORD_LAYOUT Lookup2D_FLOAT32_IEEE FNC_VALUES 1 FLOAT32_IEEE COLUMN_DIR DIRECT /end RECORD_LAYOUT
/begin RECORD_LAYOUT Lookup2D_X_FLOAT32_IEEE AXIS_PTS_X 1 FLOAT32_IEEE INDEX_INCR DIRECT /end RECORD_LAYOUT
/begin RECORD_LAYOUT Lookup2D_FLOAT64_IEEE FNC_VALUES 1 FLOAT64_IEEE COLUMN_DIR DIRECT /end RECORD_LAYOUT
/begin RECORD_LAYOUT Lookup2D_X_FLOAT64_IEEE AXIS_PTS_X 1 FLOAT64_IEEE INDEX_INCR DIRECT /end RECORD_LAYOUT
/begin CHARACTERISTIC VAL_Angle_Broadcast_FrameType " " VALUE @MemoryAddress@VAL_Angle_Broadcast_FrameType@ Scalar_UBYTE 0 COMPU_METHOD_1 0 1 /end CHARACTERISTIC
/begin CHARACTERISTIC VAL_Acceleration_Broadcast_FrameType " " VALUE @MemoryAddress@VAL_Acceleration_Broadcast_FrameType@ Scalar_UBYTE 0 COMPU_METHOD_1 0 1 /end CHARACTERISTIC
/begin CHARACTERISTIC VAL_Angle_Broadcast_CANID " " VALUE @MemoryAddress@VAL_Angle_Broadcast_CANID@ Scalar_ULONG 0 COMPU_METHOD_1 0 4294967295 /end CHARACTERISTIC
/begin CHARACTERISTIC VAL_Acceleration_Broadcast_CANID " " VALUE @MemoryAddress@VAL_Acceleration_Broadcast_CANID@ Scalar_ULONG 0 COMPU_METHOD_1 0 4294967295 /end CHARACTERISTIC
/begin CHARACTERISTIC VAL_CAN0_BaudRate " " VALUE @MemoryAddress@VAL_CAN0_BaudRate@ Scalar_UBYTE 0 COMPU_METHOD_1 0 255 /end CHARACTERISTIC
/begin CHARACTERISTIC VAL_Acc_offset_X " " VALUE @MemoryAddress@VAL_Acc_offset_X@ Scalar_SWORD 0 COMPU_METHOD_1 -32768 32767 /end CHARACTERISTIC
/begin CHARACTERISTIC VAL_Acc_offset_Y " " VALUE @MemoryAddress@VAL_Acc_offset_Y@ Scalar_SWORD 0 COMPU_METHOD_1 -32768 32767 /end CHARACTERISTIC
/begin CHARACTERISTIC VAL_Acc_offset_Z " " VALUE @MemoryAddress@VAL_Acc_offset_Z@ Scalar_SWORD 0 COMPU_METHOD_1 -32768 32767 /end CHARACTERISTIC
/begin CHARACTERISTIC VAL_SAEJ1939_Broadcast_En " " VALUE @MemoryAddress@VAL_SAEJ1939_Broadcast_En@ Scalar_UBYTE 0 COMPU_METHOD_1 0 1 /end CHARACTERISTIC
/begin CHARACTERISTIC VAL_Angle_Broadcast_Rate " " VALUE @MemoryAddress@VAL_Angle_Broadcast_Rate@ Scalar_UWORD 0 COMPU_METHOD_171 0 65535 /end CHARACTERISTIC
/begin CHARACTERISTIC VAL_Acceleration_Broadcast_Rate " " VALUE @MemoryAddress@VAL_Acceleration_Broadcast_Rate@ Scalar_UWORD 0 COMPU_METHOD_171 0 65535 /end CHARACTERISTIC
/begin CHARACTERISTIC VAL_Pitch_offset " " VALUE @MemoryAddress@VAL_Pitch_offset@ Scalar_SWORD 0 COMPU_METHOD_172 -32768 32767 /end CHARACTERISTIC
/begin CHARACTERISTIC VAL_Roll_offset " " VALUE @MemoryAddress@VAL_Roll_offset@ Scalar_SWORD 0 COMPU_METHOD_172 -32768 32767 /end CHARACTERISTIC
/begin CHARACTERISTIC VAL_Acc_g " " VALUE @MemoryAddress@VAL_Acc_g@ Scalar_SWORD 0 COMPU_METHOD_1 -32768 32767 /end CHARACTERISTIC
/begin MEASUREMENT Roll_Angle_Output " " SWORD COMPU_METHOD_172 0 0 -32768 32767 ECU_ADDRESS @MemoryAddress@Roll_Angle_Output@ /end MEASUREMENT
/begin MEASUREMENT Pitch_Angle_Output " " SWORD COMPU_METHOD_172 0 0 -32768 32767 ECU_ADDRESS @MemoryAddress@Pitch_Angle_Output@ /end MEASUREMENT
/begin MEASUREMENT X_acc " " SWORD COMPU_METHOD_173 0 0 -32768 32767 ECU_ADDRESS @MemoryAddress@X_acc@ /end MEASUREMENT
/begin MEASUREMENT g_output " " UWORD COMPU_METHOD_1 0 0 0 65535 ECU_ADDRESS @MemoryAddress@g_output@ /end MEASUREMENT
/begin MEASUREMENT lastAx " " SWORD COMPU_METHOD_1 0 0 -32768 32767 ECU_ADDRESS @MemoryAddress@lastAx@ /end MEASUREMENT
/begin MEASUREMENT lastAy " " SWORD COMPU_METHOD_1 0 0 -32768 32767 ECU_ADDRESS @MemoryAddress@lastAy@ /end MEASUREMENT
/begin MEASUREMENT lastAz " " SWORD COMPU_METHOD_1 0 0 -32768 32767 ECU_ADDRESS @MemoryAddress@lastAz@ /end MEASUREMENT
/begin CHARACTERISTIC CUR_Customer_Inf "Customer infomation" CURVE @MemoryAddress@CUR_Customer_Inf@ Lookup1D_UBYTE 0 COMPU_METHOD_1 0 255
 /begin AXIS_DESCR COM_AXIS NO_INPUT_QUANTITY COMPU_METHOD_1 18 0 255 AXIS_PTS_REF CUR_Customer_Index /end AXIS_DESCR
/end CHARACTERISTIC
/begin AXIS_PTS CUR_Customer_Index "Customer infomation" @MemoryAddress@CUR_Customer_Index@ NO_INPUT_QUANTITY Lookup1D_X_UBYTE 0 COMPU_METHOD_1 18 0 255 /end AXIS_PTS
/begin CHARACTERISTIC CUR_Wf_Ldp "characteristic curve: fuel wall film, depenedent on Load predicted " CURVE @MemoryAddress@CUR_Wf_Ldp@ Lookup1D_UWORD 0 COMPU_METHOD_2 0 1.22878E+004
 /begin AXIS_DESCR COM_AXIS NO_INPUT_QUANTITY COMPU_METHOD_3 18 0 150 AXIS_PTS_REF BP_Wf_Ldp /end AXIS_DESCR
/end CHARACTERISTIC
/begin AXIS_PTS BP_Wf_Ldp "break points, fuel wall film, depenedent on Load predicted" @MemoryAddress@BP_Wf_Ldp@ NO_INPUT_QUANTITY Lookup1D_X_UWORD 0 COMPU_METHOD_3 18 0 150 /end AXIS_PTS
/begin CHARACTERISTIC CUR_fWmp_Tm "Char. Curve, warm-up factor, dependent on engine temp." CURVE @MemoryAddress@CUR_fWmp_Tm@ Lookup1D_UBYTE 0 COMPU_METHOD_4 0 2
 /begin AXIS_DESCR COM_AXIS Tm COMPU_METHOD_5 12 -40 278 AXIS_PTS_REF BP_fWmp_Tm /end AXIS_DESCR
/end CHARACTERISTIC
/begin AXIS_PTS BP_fWmp_Tm "prelookup break points, engine temperature  " @MemoryAddress@BP_fWmp_Tm@ Tm Lookup1D_X_UBYTE 0 COMPU_METHOD_5 12 -40 278 /end AXIS_PTS
/begin CHARACTERISTIC CUR_fAst_TmSta "input<BP_fAst_TmSta>, after start enrichment factor" CURVE @MemoryAddress@CUR_fAst_TmSta@ Lookup1D_UBYTE 0 COMPU_METHOD_6 0 8
 /begin AXIS_DESCR COM_AXIS NO_INPUT_QUANTITY COMPU_METHOD_5 12 -40 278 AXIS_PTS_REF BP_fAst_TmSta /end AXIS_DESCR
/end CHARACTERISTIC
/begin AXIS_PTS BP_fAst_TmSta "input<TmSta>, break points,engine temperature at start " @MemoryAddress@BP_fAst_TmSta@ NO_INPUT_QUANTITY Lookup1D_X_UBYTE 0 COMPU_METHOD_5 12 -40 278 /end AXIS_PTS
/begin CHARACTERISTIC MAP_fVe_Map_N "Factor Volumatric Efficiency, dependent on pressure and engine speed" /* Chracteristic Type */ MAP @MemoryAddress@MAP_fVe_Map_N@ Lookup2D_UWORD 0 COMPU_METHOD_7 0 2
 /begin AXIS_DESCR /* Description of Y-Axis Points */ COM_AXIS Pim COMPU_METHOD_8 16 0 2560 AXIS_PTS_REF BP_fVe_Map /end AXIS_DESCR
 /begin AXIS_DESCR COM_AXIS N COMPU_METHOD_9 12 0 16383 AXIS_PTS_REF BP_fVe_N /end AXIS_DESCR
/end CHARACTERISTIC
/begin AXIS_PTS BP_fVe_N "input<N>, break point, engine speed, for Volumatric Efficiency factor" @MemoryAddress@BP_fVe_N@ N Lookup2D_X_UWORD 0 COMPU_METHOD_9 12 0 16383 /end AXIS_PTS
/begin AXIS_PTS BP_fVe_Map "input<Map>, break point, manifold absolute pressure, for Volumatric Efficiency factor" @MemoryAddress@BP_fVe_Map@ Pim Lookup2D_X_UWORD 0 COMPU_METHOD_8 16 0 2560 /end AXIS_PTS
/begin MEASUREMENT RPM "Engine speed" UWORD COMPU_METHOD_7 0 0 0 16383 ECU_ADDRESS @MemoryAddress@RPM@ /end MEASUREMENT
/begin MEASUREMENT N "Engine speed" UWORD COMPU_METHOD_7 0 0 0 16383 ECU_ADDRESS 0x3B9A /end MEASUREMENT
/begin MEASUREMENT MAP "" UWORD COMPU_METHOD_12 0 0 0 102000 ECU_ADDRESS 0x3B94 /end MEASUREMENT
/begin MEASUREMENT TPS "" UWORD COMPU_METHOD_6 0 0 0 100 ECU_ADDRESS 0x3B98 /end MEASUREMENT
/begin MEASUREMENT Tooth_Period "" UWORD COMPU_METHOD_19 0 0 0 65535 ECU_ADDRESS 0x3B85 /end MEASUREMENT
/begin MEASUREMENT LOAD "" UWORD COMPU_METHOD_20 0 0 0 100 ECU_ADDRESS 0x255A /end MEASUREMENT
/begin MEASUREMENT ECT "" UWORD COMPU_METHOD_3 0 0 -50 200 ECU_ADDRESS @MemoryAddress@ECT@ /end MEASUREMENT
/begin MEASUREMENT IAT "Engine speed" UWORD COMPU_METHOD_3 0 0 -50 200 ECU_ADDRESS @MemoryAddress@IAT@ /end MEASUREMENT
/begin MEASUREMENT O2S "" UWORD COMPU_METHOD_3 0 0 0 5 ECU_ADDRESS @MemoryAddress@O2S@ /end MEASUREMENT
/begin MEASUREMENT SPARK "" UWORD COMPU_METHOD_3 0 0 -90 90 ECU_ADDRESS @MemoryAddress@SPARK@ /end MEASUREMENT
/begin MEASUREMENT FUELPW1 "" UWORD COMPU_METHOD_3 0 0 0 20 ECU_ADDRESS @MemoryAddress@FUELPW1@ /end MEASUREMENT
/begin MEASUREMENT FUELPW2 "" UWORD COMPU_METHOD_3 0 0 0 20 ECU_ADDRESS @MemoryAddress@FUELPW2@ /end MEASUREMENT
/begin MEASUREMENT LamWO2 "" UWORD COMPU_METHOD_3 0 0 0 16 ECU_ADDRESS @MemoryAddress@LamWO2@ /end MEASUREMENT
/begin MEASUREMENT LAMBDA1 "" UWORD COMPU_METHOD_3 0 0 0 16 ECU_ADDRESS @MemoryAddress@LAMBDA1@ /end MEASUREMENT
/begin MEASUREMENT AFR1 "" UWORD COMPU_METHOD_3 0 0 0 16 ECU_ADDRESS @MemoryAddress@AFR1@ /end MEASUREMENT
/begin MEASUREMENT O2%1 "" UWORD COMPU_METHOD_3 0 0 0 16 ECU_ADDRESS @MemoryAddress@O2%1@ /end MEASUREMENT
/begin MEASUREMENT TEMP1 "" UWORD COMPU_METHOD_3 0 0 0 16 ECU_ADDRESS @MemoryAddress@TEMP1@ /end MEASUREMENT
/begin MEASUREMENT LAMBDA2 "" UWORD COMPU_METHOD_3 0 0 0 16 ECU_ADDRESS @MemoryAddress@LAMBDA2@ /end MEASUREMENT
/begin MEASUREMENT AFR2 "" UWORD COMPU_METHOD_3 0 0 0 16 ECU_ADDRESS @MemoryAddress@AFR2@ /end MEASUREMENT
/begin MEASUREMENT O2%2 "" UWORD COMPU_METHOD_3 0 0 0 16 ECU_ADDRESS @MemoryAddress@O2%2@ /end MEASUREMENT
/begin MEASUREMENT TEMP2 "" UWORD COMPU_METHOD_3 0 0 0 16 ECU_ADDRESS @MemoryAddress@TEMP2@ /end MEASUREMENT
/begin MEASUREMENT TA "" UWORD COMPU_METHOD_3 0 0 0 16 ECU_ADDRESS @MemoryAddress@TA@ /end MEASUREMENT
/begin MEASUREMENT TE "" UWORD COMPU_METHOD_3 0 0 0 16 ECU_ADDRESS @MemoryAddress@TE@ /end MEASUREMENT
/begin MEASUREMENT PA "" UWORD COMPU_METHOD_3 0 0 0 16 ECU_ADDRESS @MemoryAddress@PA@ /end MEASUREMENT
/begin MEASUREMENT PE "" UWORD COMPU_METHOD_3 0 0 0 16 ECU_ADDRESS @MemoryAddress@PE@ /end MEASUREMENT
/begin COMPU_METHOD COMPU_METHOD_1 "Q = V" RAT_FUNC "%0.6f" "" COEFFS 0 1 0 0 0 1 /end COMPU_METHOD
/begin COMPU_METHOD COMPU_METHOD_2 "Q = V*5.333333" RAT_FUNC "%0.6f" "%" COEFFS 0 5.333333 0.000000 0 0 1.000000 /end COMPU_METHOD
/begin COMPU_METHOD COMPU_METHOD_3 "Q = V*42.666667" RAT_FUNC "%0.6f" "%" COEFFS 0 42.666667 0.000000 0 0 1.000000 /end COMPU_METHOD
/begin COMPU_METHOD COMPU_METHOD_4 "Q = V*128.000000" RAT_FUNC "%0.6f" "" COEFFS 0 128.000000 0.000000 0 0 1.000000 /end COMPU_METHOD
/begin COMPU_METHOD COMPU_METHOD_5 "Q = (V+40.000000)/1.250000" RAT_FUNC "%0.6f" "DegC" COEFFS 0 1.000000 40.000000 0 0 1.250000 /end COMPU_METHOD
/begin COMPU_METHOD COMPU_METHOD_6 "Q = V*32.000000" RAT_FUNC "%0.6f" "" COEFFS 0 32.000000 0.000000 0 0 1.000000 /end COMPU_METHOD
/begin COMPU_METHOD COMPU_METHOD_7 "Q = V*32768.000000" RAT_FUNC "%0.6f" "-" COEFFS 0 32768.000000 0.000000 0 0 1.000000 /end COMPU_METHOD
/begin COMPU_METHOD COMPU_METHOD_8 "Q = V*25.600000" RAT_FUNC "%0.6f" "hPa" COEFFS 0 25.600000 0.000000 0 0 1.000000 /end COMPU_METHOD
/begin COMPU_METHOD COMPU_METHOD_9 "Q = V*4.000000" RAT_FUNC "%0.6f" "Rpm" COEFFS 0 4.000000 0.000000 0 0 1.000000 /end COMPU_METHOD
/begin COMPU_METHOD COMPU_METHOD_10 "Q = V*655.360000" RAT_FUNC "%0.6f" "%" COEFFS 0 655.360000 0.000000 0 0 1.000000 /end COMPU_METHOD
/begin COMPU_METHOD COMPU_METHOD_11 "Q = V*1.333333" RAT_FUNC "%0.6f" "CrA" COEFFS 0 1.333333 0.000000 0 0 1.000000 /end COMPU_METHOD
/begin COMPU_METHOD COMPU_METHOD_12 "Q = V*1.333333" RAT_FUNC "%0.6f" "%" COEFFS 0 1.333333 0.000000 0 0 1.000000 /end COMPU_METHOD
/begin COMPU_METHOD COMPU_METHOD_13 "Q = V/60.000000" RAT_FUNC "%0.6f" "Rpm" COEFFS 0 1.000000 0.000000 0 0 60.000000 /end COMPU_METHOD
/begin COMPU_METHOD COMPU_METHOD_14 "Q = V*16384.000000" RAT_FUNC "%0.6f" "-" COEFFS 0 16384.000000 0.000000 0 0 1.000000 /end COMPU_METHOD
/begin COMPU_METHOD COMPU_METHOD_15 "Q = V*819.200000" RAT_FUNC "%0.6f" "V" COEFFS 0 819.200000 0.000000 0 0 1.000000 /end COMPU_METHOD
/begin COMPU_METHOD COMPU_METHOD_16 "Q = V*64.000000" RAT_FUNC "%0.6f" "" COEFFS 0 64.000000 0.000000 0 0 1.000000 /end COMPU_METHOD
/begin COMPU_METHOD COMPU_METHOD_17 "Q = V/10.000000" RAT_FUNC "%0.6f" "hPa" COEFFS 0 1.000000 0.000000 0 0 10.000000 /end COMPU_METHOD
/begin COMPU_METHOD COMPU_METHOD_18 "Q = V*100.000000" RAT_FUNC "%0.6f" "ms" COEFFS 0 100.000000 0.000000 0 0 1.000000 /end COMPU_METHOD
/begin COMPU_METHOD COMPU_METHOD_19 "Q = V*10.000000" RAT_FUNC "%0.6f" "V" COEFFS 0 10.000000 0.000000 0 0 1.000000 /end COMPU_METHOD
/begin COMPU_METHOD COMPU_METHOD_20 "Q = V*50.000000" RAT_FUNC "%0.6f" "ms" COEFFS 0 50.000000 0.000000 0 0 1.000000 /end COMPU_METHOD
/begin COMPU_METHOD COMPU_METHOD_21 "Q = V/60.000000" RAT_FUNC "%0.6f" "rpm" COEFFS 0 1.000000 0.000000 0 0 60.000000 /end COMPU_METHOD
/begin COMPU_METHOD COMPU_METHOD_22 "Q = V/4.000000" RAT_FUNC "%0.6f" "CrA " COEFFS 0 1.000000 0.000000 0 0 4.000000 /end COMPU_METHOD
/begin COMPU_METHOD COMPU_METHOD_23 "Q = V*1.333333" RAT_FUNC "%0.6f" "% " COEFFS 0 1.333333 0.000000 0 0 1.000000 /end COMPU_METHOD
/begin COMPU_METHOD COMPU_METHOD_24 "Q = V/4.000000" RAT_FUNC "%0.6f" "CrA" COEFFS 0 1.000000 0.000000 0 0 4.000000 /end COMPU_METHOD
/begin COMPU_METHOD COMPU_METHOD_25 "Q = V*256.000000" RAT_FUNC "%0.6f" "" COEFFS 0 256.000000 0.000000 0 0 1.000000 /end COMPU_METHOD
/begin COMPU_METHOD COMPU_METHOD_26 "Q = V*2.560000" RAT_FUNC "%0.6f" "%" COEFFS 0 2.560000 0.000000 0 0 1.000000 /end COMPU_METHOD
/begin COMPU_METHOD COMPU_METHOD_27 "Q = V*128.000000" RAT_FUNC "%0.6f" "CrA" COEFFS 0 128.000000 0.000000 0 0 1.000000 /end COMPU_METHOD
/begin COMPU_METHOD COMPU_METHOD_28 "Q = V*16384.000000" RAT_FUNC "%0.6f" "" COEFFS 0 16384.000000 0.000000 0 0 1.000000 /end COMPU_METHOD
/begin COMPU_METHOD COMPU_METHOD_29 "Q = V*327.680000" RAT_FUNC "%0.6f" "%" COEFFS 0 327.680000 0.000000 0 0 1.000000 /end COMPU_METHOD
/begin COMPU_METHOD COMPU_METHOD_30 "Q = V*4.000000" RAT_FUNC "%0.6f" "RPM" COEFFS 0 4.000000 0.000000 0 0 1.000000 /end COMPU_METHOD
/begin COMPU_METHOD COMPU_METHOD_31 "Q = V*100.000000" RAT_FUNC "%0.6f" "S" COEFFS 0 100.000000 0.000000 0 0 1.000000 /end COMPU_METHOD
/begin COMPU_METHOD COMPU_METHOD_32 "Q = V/60.000000" RAT_FUNC "%0.6f" "S" COEFFS 0 1.000000 0.000000 0 0 60.000000 /end COMPU_METHOD
/begin COMPU_METHOD COMPU_METHOD_33 "Q = V*10.000000" RAT_FUNC "%0.6f" "s" COEFFS 0 10.000000 0.000000 0 0 1.000000 /end COMPU_METHOD
/begin COMPU_METHOD COMPU_METHOD_34 "Q = V*4096.000000" RAT_FUNC "%0.6f" "-" COEFFS 0 4096.000000 0.000000 0 0 1.000000 /end COMPU_METHOD
/begin COMPU_METHOD COMPU_METHOD_35 "Q = V/16.000000" RAT_FUNC "%0.6f" "Rpm/s" COEFFS 0 1.000000 0.000000 0 0 16.000000 /end COMPU_METHOD
/begin COMPU_METHOD COMPU_METHOD_36 "Q = V*50.000000" RAT_FUNC "%0.6f" "s" COEFFS 0 50.000000 0.000000 0 0 1.000000 /end COMPU_METHOD
/begin COMPU_METHOD COMPU_METHOD_37 "Q = V*50.000000" RAT_FUNC "%0.6f" "" COEFFS 0 50.000000 0.000000 0 0 1.000000 /end COMPU_METHOD
/begin COMPU_METHOD COMPU_METHOD_38 "Q = V" RAT_FUNC "%0.6f" "us" COEFFS 0 1 0 0 0 1 /end COMPU_METHOD
/begin COMPU_METHOD COMPU_METHOD_39 "Q = V*7.812500" RAT_FUNC "%0.6f" "ms" COEFFS 0 7.812500 0.000000 0 0 1.000000 /end COMPU_METHOD
/begin COMPU_METHOD COMPU_METHOD_40 "Q = V*10.000000" RAT_FUNC "%0.6f" "ms" COEFFS 0 10.000000 0.000000 0 0 1.000000 /end COMPU_METHOD
/begin COMPU_METHOD COMPU_METHOD_41 "Q = V" RAT_FUNC "%0.6f" "s" COEFFS 0 1 0 0 0 1 /end COMPU_METHOD
/begin COMPU_METHOD COMPU_METHOD_42 "Q = V*32768.000000" RAT_FUNC "%0.6f" "" COEFFS 0 32768.000000 0.000000 0 0 1.000000 /end COMPU_METHOD
/begin COMPU_METHOD COMPU_METHOD_43 "Q = V*4.000000" RAT_FUNC "%0.6f" "" COEFFS 0 4.000000 0.000000 0 0 1.000000 /end COMPU_METHOD
/begin COMPU_METHOD COMPU_METHOD_44 "Q = V/1.250000" RAT_FUNC "%0.6f" "DegC" COEFFS 0 1.000000 0.000000 0 0 1.250000 /end COMPU_METHOD
/begin COMPU_METHOD COMPU_METHOD_45 "Q = V*1280.000000" RAT_FUNC "%0.6f" "DegC" COEFFS 0 1280.000000 0.000000 0 0 1.000000 /end COMPU_METHOD
/begin COMPU_METHOD COMPU_METHOD_46 "Q = V/6.144000" RAT_FUNC "%0.6f" "kg/h" COEFFS 0 1.000000 0.000000 0 0 6.144000 /end COMPU_METHOD
/begin COMPU_METHOD COMPU_METHOD_47 "Q = (V+50.000000)/5.000000" RAT_FUNC "%0.6f" "DegC" COEFFS 0 1.000000 50.000000 0 0 5.000000 /end COMPU_METHOD
/begin COMPU_METHOD COMPU_METHOD_48 "Q = (V+40.000000)/1.250000" RAT_FUNC "%0.6f" "deg C" COEFFS 0 1.000000 40.000000 0 0 1.250000 /end COMPU_METHOD
/begin COMPU_METHOD COMPU_METHOD_49 "Q = V*256.000000" RAT_FUNC "%0.6f" "DegC" COEFFS 0 256.000000 0.000000 0 0 1.000000 /end COMPU_METHOD
/begin COMPU_METHOD COMPU_METHOD_50 "Q = V*64.000000" RAT_FUNC "%0.6f" "DegC" COEFFS 0 64.000000 0.000000 0 0 1.000000 /end COMPU_METHOD
/begin COMPU_METHOD COMPU_METHOD_51 "Q = V*640.000000" RAT_FUNC "%0.6f" "" COEFFS 0 640.000000 0.000000 0 0 1.000000 /end COMPU_METHOD
/begin COMPU_METHOD COMPU_METHOD_52 "Q = (V+0.100000)*640.000000" RAT_FUNC "%0.6f" "" COEFFS 0 640.000000 64.000000 0 0 1.000000 /end COMPU_METHOD
/begin COMPU_METHOD COMPU_METHOD_53 "Q = V/5.000000" RAT_FUNC "%0.6f" "DegC" COEFFS 0 1.000000 0.000000 0 0 5.000000 /end COMPU_METHOD
/begin COMPU_METHOD COMPU_METHOD_54 "Q = V*5.000000" RAT_FUNC "%0.6f" "s" COEFFS 0 5.000000 0.000000 0 0 1.000000 /end COMPU_METHOD
/begin COMPU_METHOD COMPU_METHOD_55 "Q = V*41.666667" RAT_FUNC "%0.6f" "kg/h" COEFFS 0 41.666667 0.000000 0 0 1.000000 /end COMPU_METHOD
/begin COMPU_METHOD COMPU_METHOD_56 "Q = V/5.000000" RAT_FUNC "%0.6f" "Drg C" COEFFS 0 1.000000 0.000000 0 0 5.000000 /end COMPU_METHOD
/begin COMPU_METHOD COMPU_METHOD_57 "Q = V/10.000000" RAT_FUNC "%0.6f" "Rpm" COEFFS 0 1.000000 0.000000 0 0 10.000000 /end COMPU_METHOD
/begin COMPU_METHOD COMPU_METHOD_58 "Q = V*41.666667" RAT_FUNC "%0.6f" "Kg/h" COEFFS 0 41.666667 0.000000 0 0 1.000000 /end COMPU_METHOD
/begin COMPU_METHOD COMPU_METHOD_59 "Q = V" RAT_FUNC "%0.6f" "10ms" COEFFS 0 1 0 0 0 1 /end COMPU_METHOD
/begin COMPU_METHOD COMPU_METHOD_60 "Q = V*4.000000" RAT_FUNC "%0.6f" "rpm" COEFFS 0 4.000000 0.000000 0 0 1.000000 /end COMPU_METHOD
/begin COMPU_METHOD COMPU_METHOD_61 "Q = V*4.000000" RAT_FUNC "%0.6f" "Hz" COEFFS 0 4.000000 0.000000 0 0 1.000000 /end COMPU_METHOD
/begin COMPU_METHOD COMPU_METHOD_62 "Q = V*160.000000" RAT_FUNC "%0.6f" "V" COEFFS 0 160.000000 0.000000 0 0 1.000000 /end COMPU_METHOD
/begin COMPU_METHOD COMPU_METHOD_63 "Q = V*2000.000000" RAT_FUNC "%0.6f" "ms" COEFFS 0 2000.000000 0.000000 0 0 1.000000 /end COMPU_METHOD
/begin COMPU_METHOD COMPU_METHOD_64 "Q = V*4096.000000" RAT_FUNC "%0.6f" "" COEFFS 0 4096.000000 0.000000 0 0 1.000000 /end COMPU_METHOD
/begin COMPU_METHOD COMPU_METHOD_65 "Q = V*100.000000" RAT_FUNC "%0.6f" "s" COEFFS 0 100.000000 0.000000 0 0 1.000000 /end COMPU_METHOD
/begin COMPU_METHOD COMPU_METHOD_66 "Q = V*128.000000" RAT_FUNC "%0.6f" "km/h" COEFFS 0 128.000000 0.000000 0 0 1.000000 /end COMPU_METHOD
/begin COMPU_METHOD COMPU_METHOD_67 "Q = V*2.000000" RAT_FUNC "%0.6f" "Rpm/s" COEFFS 0 2.000000 0.000000 0 0 1.000000 /end COMPU_METHOD
/begin COMPU_METHOD COMPU_METHOD_68 "Q = V*26214.400000" RAT_FUNC "%0.6f" "%/hPa" COEFFS 0 26214.400000 0.000000 0 0 1.000000 /end COMPU_METHOD
/begin COMPU_METHOD COMPU_METHOD_69 "Q = V*10.000000" RAT_FUNC "%0.6f" "mL/dT" COEFFS 0 10.000000 0.000000 0 0 1.000000 /end COMPU_METHOD
/begin COMPU_METHOD COMPU_METHOD_70 "Q = V*10.000000" RAT_FUNC "%0.6f" "s " COEFFS 0 10.000000 0.000000 0 0 1.000000 /end COMPU_METHOD
/begin COMPU_METHOD COMPU_METHOD_71 "Q = V*10.000000" RAT_FUNC "%0.6f" "mL" COEFFS 0 10.000000 0.000000 0 0 1.000000 /end COMPU_METHOD
/begin COMPU_METHOD COMPU_METHOD_72 "Q = V*13107.200000" RAT_FUNC "%0.6f" "1/s" COEFFS 0 13107.200000 0.000000 0 0 1.000000 /end COMPU_METHOD
/begin COMPU_METHOD COMPU_METHOD_73 "Q = V*13107.200000" RAT_FUNC "%0.6f" "" COEFFS 0 13107.200000 0.000000 0 0 1.000000 /end COMPU_METHOD
/begin COMPU_METHOD COMPU_METHOD_74 "Q = V*64.000000" RAT_FUNC "%0.6f" "hPa/V" COEFFS 0 64.000000 0.000000 0 0 1.000000 /end COMPU_METHOD
/begin COMPU_METHOD COMPU_METHOD_75 "Q = V*32768.000000" RAT_FUNC "%0.6f" "ms" COEFFS 0 32768.000000 0.000000 0 0 1.000000 /end COMPU_METHOD
/begin COMPU_METHOD COMPU_METHOD_76 "Q = V*65536.000000" RAT_FUNC "%0.6f" "" COEFFS 0 65536.000000 0.000000 0 0 1.000000 /end COMPU_METHOD
/begin COMPU_METHOD COMPU_METHOD_77 "Q = V*65536.000000" RAT_FUNC "%0.6f" "Kg/L" COEFFS 0 65536.000000 0.000000 0 0 1.000000 /end COMPU_METHOD
/begin COMPU_METHOD COMPU_METHOD_78 "Q = V*12.800000" RAT_FUNC "%0.6f" "hPa" COEFFS 0 12.800000 0.000000 0 0 1.000000 /end COMPU_METHOD
/begin COMPU_METHOD COMPU_METHOD_79 "Q = V/60.000000" RAT_FUNC "%0.6f" "s" COEFFS 0 1.000000 0.000000 0 0 60.000000 /end COMPU_METHOD
/begin COMPU_METHOD COMPU_METHOD_80 "Q = V*16.666667" RAT_FUNC "%0.6f" "" COEFFS 0 16.666667 0.000000 0 0 1.000000 /end COMPU_METHOD
/begin COMPU_METHOD COMPU_METHOD_81 "Q = V*16.666667" RAT_FUNC "%0.6f" "s" COEFFS 0 16.666667 0.000000 0 0 1.000000 /end COMPU_METHOD
/begin COMPU_METHOD COMPU_METHOD_82 "Q = V*1447.649280" RAT_FUNC "%0.6f" "m" COEFFS 0 1447.649280 0.000000 0 0 1.000000 /end COMPU_METHOD
/begin COMPU_METHOD COMPU_METHOD_83 "Q = V*16384.000000" RAT_FUNC "%0.6f" "/V" COEFFS 0 16384.000000 0.000000 0 0 1.000000 /end COMPU_METHOD
/begin COMPU_METHOD COMPU_METHOD_84 "Q = V*81920.000000" RAT_FUNC "%0.6f" "V/%" COEFFS 0 81920.000000 0.000000 0 0 1.000000 /end COMPU_METHOD
/begin COMPU_METHOD COMPU_METHOD_85 "Q = V*838.860800" RAT_FUNC "%0.6f" "V/ms" COEFFS 0 838.860800 0.000000 0 0 1.000000 /end COMPU_METHOD
/begin COMPU_METHOD COMPU_METHOD_86 "Q = V*200000.000000" RAT_FUNC "%0.6f" "ms/%" COEFFS 0 200000.000000 0.000000 0 0 1.000000 /end COMPU_METHOD
/begin COMPU_METHOD COMPU_METHOD_87 "Q = V*10000.000000" RAT_FUNC "%0.6f" "ms/V" COEFFS 0 10000.000000 0.000000 0 0 1.000000 /end COMPU_METHOD
/begin COMPU_METHOD COMPU_METHOD_88 "Q = V*1000.000000" RAT_FUNC "%0.6f" "ms" COEFFS 0 1000.000000 0.000000 0 0 1.000000 /end COMPU_METHOD
/begin COMPU_METHOD COMPU_METHOD_89 "Q = V*1000.000000" RAT_FUNC "%0.6f" "s" COEFFS 0 1000.000000 0.000000 0 0 1.000000 /end COMPU_METHOD
/begin COMPU_METHOD COMPU_METHOD_90 "Q = V*1000.000000" RAT_FUNC "%0.6f" "L" COEFFS 0 1000.000000 0.000000 0 0 1.000000 /end COMPU_METHOD
/begin COMPU_METHOD COMPU_METHOD_91 "Q = V*50.842514" RAT_FUNC "%0.6f" "cc" COEFFS 0 50.842514 0.000000 0 0 1.000000 /end COMPU_METHOD
/begin COMPU_METHOD COMPU_METHOD_92 "Q = V*218453.333333" RAT_FUNC "%0.6f" "%/hPa" COEFFS 0 218453.333333 0.000000 0 0 1.000000 /end COMPU_METHOD
/begin COMPU_METHOD COMPU_METHOD_93 "Q = V*1024.000000" RAT_FUNC "%0.6f" "-" COEFFS 0 1024.000000 0.000000 0 0 1.000000 /end COMPU_METHOD
/begin COMPU_METHOD COMPU_METHOD_94 "Q = V*21.333333" RAT_FUNC "%0.6f" "%" COEFFS 0 21.333333 0.000000 0 0 1.000000 /end COMPU_METHOD
/begin COMPU_METHOD COMPU_METHOD_95 "Q = V*86.253701" RAT_FUNC "%0.6f" "g/min" COEFFS 0 86.253701 0.000000 0 0 1.000000 /end COMPU_METHOD
/begin COMPU_METHOD COMPU_METHOD_96 "Q = (V+50.000000)*51.200000" RAT_FUNC "%0.6f" "DegC" COEFFS 0 51.200000 2560.000000 0 0 1.000000 /end COMPU_METHOD
/begin COMPU_METHOD COMPU_METHOD_97 "Q = V*150.000000" RAT_FUNC "%0.6f" "g" COEFFS 0 150.000000 0.000000 0 0 1.000000 /end COMPU_METHOD
/begin COMPU_METHOD COMPU_METHOD_98 "Q = V*170.666667" RAT_FUNC "%0.6f" "%" COEFFS 0 170.666667 0.000000 0 0 1.000000 /end COMPU_METHOD
/begin COMPU_METHOD COMPU_METHOD_99 "Q = V*20480.000000" RAT_FUNC "%0.6f" "Lam/V" COEFFS 0 20480.000000 0.000000 0 0 1.000000 /end COMPU_METHOD
/begin COMPU_METHOD COMPU_METHOD_100 "Q = V*1024.000000" RAT_FUNC "%0.6f" "" COEFFS 0 1024.000000 0.000000 0 0 1.000000 /end COMPU_METHOD
/begin COMPU_METHOD COMPU_METHOD_101 "Q = V" RAT_FUNC "%0.6f" "CrA" COEFFS 0 1 0 0 0 1 /end COMPU_METHOD
/begin COMPU_METHOD COMPU_METHOD_102 "Q = V" RAT_FUNC "%0.6f" "-" COEFFS 0 1 0 0 0 1 /end COMPU_METHOD
/begin COMPU_METHOD COMPU_METHOD_103 "Q = V*128.000000" RAT_FUNC "%0.6f" "-" COEFFS 0 128.000000 0.000000 0 0 1.000000 /end COMPU_METHOD
/begin COMPU_METHOD COMPU_METHOD_104 "Q = V*1.333333" RAT_FUNC "%0.6f" "Km/h" COEFFS 0 1.333333 0.000000 0 0 1.000000 /end COMPU_METHOD
/begin COMPU_METHOD COMPU_METHOD_105 "Q = V*10.000000" RAT_FUNC "%0.6f" "Km/h" COEFFS 0 10.000000 0.000000 0 0 1.000000 /end COMPU_METHOD
/begin COMPU_METHOD COMPU_METHOD_106 "Q = V*2560.000000" RAT_FUNC "%0.6f" "CrA/Rpm" COEFFS 0 2560.000000 0.000000 0 0 1.000000 /end COMPU_METHOD
/begin COMPU_METHOD COMPU_METHOD_107 "Q = V/10.000000" RAT_FUNC "%0.6f" "RPM" COEFFS 0 1.000000 0.000000 0 0 10.000000 /end COMPU_METHOD
/begin COMPU_METHOD COMPU_METHOD_108 "Q = V/6.144000" RAT_FUNC "%0.6f" "Kg/h" COEFFS 0 1.000000 0.000000 0 0 6.144000 /end COMPU_METHOD
/begin COMPU_METHOD COMPU_METHOD_109 "Q = V/1.250000" RAT_FUNC "%0.6f" "Km/h" COEFFS 0 1.000000 0.000000 0 0 1.250000 /end COMPU_METHOD
/begin COMPU_METHOD COMPU_METHOD_110 "Q = V/1.250000" RAT_FUNC "%0.6f" "s" COEFFS 0 1.000000 0.000000 0 0 1.250000 /end COMPU_METHOD
/begin COMPU_METHOD COMPU_METHOD_111 "Q = V*36.621094" RAT_FUNC "%0.6f" "Kg" COEFFS 0 36.621094 0.000000 0 0 1.000000 /end COMPU_METHOD
/begin COMPU_METHOD COMPU_METHOD_112 "Q = V*36.621094" RAT_FUNC "%0.6f" "kg" COEFFS 0 36.621094 0.000000 0 0 1.000000 /end COMPU_METHOD
/begin COMPU_METHOD COMPU_METHOD_113 "Q = V*8.000000" RAT_FUNC "%0.6f" "" COEFFS 0 8.000000 0.000000 0 0 1.000000 /end COMPU_METHOD
/begin COMPU_METHOD COMPU_METHOD_114 "Q = V*170.666667" RAT_FUNC "%0.6f" "" COEFFS 0 170.666667 0.000000 0 0 1.000000 /end COMPU_METHOD
/begin COMPU_METHOD COMPU_METHOD_115 "Q = V/1.245313" RAT_FUNC "%0.6f" "Km/h" COEFFS 0 1.000000 0.000000 0 0 1.245313 /end COMPU_METHOD
/begin COMPU_METHOD COMPU_METHOD_116 "Q = V*100.000000" RAT_FUNC "%0.6f" "" COEFFS 0 100.000000 0.000000 0 0 1.000000 /end COMPU_METHOD
/begin COMPU_METHOD COMPU_METHOD_117 "Q = (V+0.200000)*191.760300" RAT_FUNC "%0.6f" "V" COEFFS 0 191.760300 38.352060 0 0 1.000000 /end COMPU_METHOD
/begin COMPU_METHOD COMPU_METHOD_118 "Q = V*3.276800" RAT_FUNC "%0.6f" "%/s" COEFFS 0 3.276800 0.000000 0 0 1.000000 /end COMPU_METHOD
/begin COMPU_METHOD COMPU_METHOD_119 "Q = V*20.480000" RAT_FUNC "%0.6f" "%" COEFFS 0 20.480000 0.000000 0 0 1.000000 /end COMPU_METHOD
/begin COMPU_METHOD COMPU_METHOD_120 "Q = V*460.800000" RAT_FUNC "%0.6f" "m" COEFFS 0 460.800000 0.000000 0 0 1.000000 /end COMPU_METHOD
/begin COMPU_METHOD COMPU_METHOD_121 "Q = V*78.967622" RAT_FUNC "%0.6f" "mg" COEFFS 0 78.967622 0.000000 0 0 1.000000 /end COMPU_METHOD
/begin COMPU_METHOD COMPU_METHOD_122 "Q = V*900.000000" RAT_FUNC "%0.6f" "Km" COEFFS 0 900.000000 0.000000 0 0 1.000000 /end COMPU_METHOD
/begin COMPU_METHOD COMPU_METHOD_123 "Q = V" RAT_FUNC "%0.6f" "g" COEFFS 0 1 0 0 0 1 /end COMPU_METHOD
/begin COMPU_METHOD COMPU_METHOD_124 "Q = V" RAT_FUNC "%0.6f" "mL" COEFFS 0 1 0 0 0 1 /end COMPU_METHOD
/begin COMPU_METHOD COMPU_METHOD_125 "Q = V*2000.000000" RAT_FUNC "%0.6f" "(kg/h)/(%)" COEFFS 0 2000.000000 0.000000 0 0 1.000000 /end COMPU_METHOD
/begin COMPU_METHOD COMPU_METHOD_126 "Q = V*100.000000" RAT_FUNC "%0.6f" "g/s" COEFFS 0 100.000000 0.000000 0 0 1.000000 /end COMPU_METHOD
/begin COMPU_METHOD COMPU_METHOD_127 "Q = V*256.000000" RAT_FUNC "%0.6f" "kPa" COEFFS 0 256.000000 0.000000 0 0 1.000000 /end COMPU_METHOD
/begin COMPU_METHOD COMPU_METHOD_128 "Q = V*204.800000" RAT_FUNC "%0.6f" "V" COEFFS 0 204.800000 0.000000 0 0 1.000000 /end COMPU_METHOD
/begin COMPU_METHOD COMPU_METHOD_129 "Q = V*128.000000" RAT_FUNC "%0.6f" "Km/h" COEFFS 0 128.000000 0.000000 0 0 1.000000 /end COMPU_METHOD
/begin COMPU_METHOD COMPU_METHOD_130 "Q = V*460.800000" RAT_FUNC "%0.6f" "m/s" COEFFS 0 460.800000 0.000000 0 0 1.000000 /end COMPU_METHOD
/begin COMPU_METHOD COMPU_METHOD_131 "Q = V*1000.000000" RAT_FUNC "%0.6f" "V" COEFFS 0 1000.000000 0.000000 0 0 1.000000 /end COMPU_METHOD
/begin COMPU_METHOD COMPU_METHOD_132 "Q = V*32768000.000000" RAT_FUNC "%0.6f" "(kg/h)/(1/min)(%)" COEFFS 0 32768000.000000 0.000000 0 0 1.000000 /end COMPU_METHOD
/begin COMPU_METHOD COMPU_METHOD_133 "Q = V*8192.000000" RAT_FUNC "%0.6f" "" COEFFS 0 8192.000000 0.000000 0 0 1.000000 /end COMPU_METHOD
/begin COMPU_METHOD COMPU_METHOD_134 "Q = V*96000.000000" RAT_FUNC "%0.6f" "ms/%" COEFFS 0 96000.000000 0.000000 0 0 1.000000 /end COMPU_METHOD
/begin COMPU_METHOD COMPU_METHOD_135 "Q = V*1370.965655" RAT_FUNC "%0.6f" "Kg/Hr" COEFFS 0 1370.965655 0.000000 0 0 1.000000 /end COMPU_METHOD
/begin COMPU_METHOD COMPU_METHOD_136 "Q = V*9375.000000" RAT_FUNC "%0.6f" "kg" COEFFS 0 9375.000000 0.000000 0 0 1.000000 /end COMPU_METHOD
/begin COMPU_METHOD COMPU_METHOD_137 "Q = V*51.200000" RAT_FUNC "%0.6f" "DegC" COEFFS 0 51.200000 0.000000 0 0 1.000000 /end COMPU_METHOD
/begin COMPU_METHOD COMPU_METHOD_138 "Q = V*150.000000" RAT_FUNC "%0.6f" "g/s" COEFFS 0 150.000000 0.000000 0 0 1.000000 /end COMPU_METHOD
/begin COMPU_METHOD COMPU_METHOD_139 "Q = V*32768.000000" RAT_FUNC "%0.6f" "%" COEFFS 0 32768.000000 0.000000 0 0 1.000000 /end COMPU_METHOD
/begin COMPU_METHOD COMPU_METHOD_140 "Q = V*640.000000" RAT_FUNC "%0.6f" "Kg/h" COEFFS 0 640.000000 0.000000 0 0 1.000000 /end COMPU_METHOD
/begin COMPU_METHOD COMPU_METHOD_141 "Q = V*4.608000" RAT_FUNC "%0.6f" "m/s^2" COEFFS 0 4.608000 0.000000 0 0 1.000000 /end COMPU_METHOD
/begin COMPU_METHOD COMPU_METHOD_142 "Q = V*2.550039" RAT_FUNC "%0.6f" "%" COEFFS 0 2.550039 0.000000 0 0 1.000000 /end COMPU_METHOD
/begin COMPU_METHOD COMPU_METHOD_143 "Q = V*56.250000" RAT_FUNC "%0.6f" "Km" COEFFS 0 56.250000 0.000000 0 0 1.000000 /end COMPU_METHOD
/begin COMPU_METHOD COMPU_METHOD_144 "Q = V*90.506250" RAT_FUNC "%0.6f" "Mile" COEFFS 0 90.506250 0.000000 0 0 1.000000 /end COMPU_METHOD
/begin COMPU_METHOD COMPU_METHOD_145 "Q = V*23.901401" RAT_FUNC "%0.6f" "MPG" COEFFS 0 23.901401 0.000000 0 0 1.000000 /end COMPU_METHOD
/begin COMPU_METHOD COMPU_METHOD_146 "Q = V*13.709657" RAT_FUNC "%0.6f" "L/100Km" COEFFS 0 13.709657 0.000000 0 0 1.000000 /end COMPU_METHOD
/begin COMPU_METHOD COMPU_METHOD_147 "Q = V*95.605604" RAT_FUNC "%0.6f" "Hrs/Kg" COEFFS 0 95.605604 0.000000 0 0 1.000000 /end COMPU_METHOD
/begin COMPU_METHOD COMPU_METHOD_148 "Q = V*95.605604" RAT_FUNC "%0.6f" "Hrs/Lit" COEFFS 0 95.605604 0.000000 0 0 1.000000 /end COMPU_METHOD
/begin COMPU_METHOD COMPU_METHOD_149 "Q = V*4.935476" RAT_FUNC "%0.6f" "mg/s" COEFFS 0 4.935476 0.000000 0 0 1.000000 /end COMPU_METHOD
/begin COMPU_METHOD COMPU_METHOD_150 "Q = V*1.204950" RAT_FUNC "%0.6f" "g" COEFFS 0 1.204950 0.000000 0 0 1.000000 /end COMPU_METHOD
/begin COMPU_METHOD COMPU_METHOD_151 "Q = V*47.802802" RAT_FUNC "%0.6f" "Km/Kg" COEFFS 0 47.802802 0.000000 0 0 1.000000 /end COMPU_METHOD
/begin COMPU_METHOD COMPU_METHOD_152 "Q = V*47.802802" RAT_FUNC "%0.6f" "Km/L" COEFFS 0 47.802802 0.000000 0 0 1.000000 /end COMPU_METHOD
/begin COMPU_METHOD COMPU_METHOD_153 "Q = V*47.802802" RAT_FUNC "%0.6f" "m/g" COEFFS 0 47.802802 0.000000 0 0 1.000000 /end COMPU_METHOD
/begin COMPU_METHOD COMPU_METHOD_154 "Q = V*5175.222058" RAT_FUNC "%0.6f" "mg/ms" COEFFS 0 5175.222058 0.000000 0 0 1.000000 /end COMPU_METHOD
/begin COMPU_METHOD COMPU_METHOD_155 "Q = V*666.666667" RAT_FUNC "%0.6f" "Kg/h" COEFFS 0 666.666667 0.000000 0 0 1.000000 /end COMPU_METHOD
/begin COMPU_METHOD COMPU_METHOD_156 "Q = V*666.666667" RAT_FUNC "%0.6f" "kg/h" COEFFS 0 666.666667 0.000000 0 0 1.000000 /end COMPU_METHOD
/begin COMPU_METHOD COMPU_METHOD_157 "Q = V" RAT_FUNC "%0.6f" "Logic" COEFFS 0 1 0 0 0 1 /end COMPU_METHOD
/begin COMPU_METHOD COMPU_METHOD_158 "Q = V*2.000000" RAT_FUNC "%0.6f" "CrA" COEFFS 0 2.000000 0.000000 0 0 1.000000 /end COMPU_METHOD
/begin COMPU_METHOD COMPU_METHOD_159 "Q = V*2.000000" RAT_FUNC "%0.6f" "%" COEFFS 0 2.000000 0.000000 0 0 1.000000 /end COMPU_METHOD
/begin COMPU_METHOD COMPU_METHOD_160 "Q = V*32.000000" RAT_FUNC "%0.6f" "-" COEFFS 0 32.000000 0.000000 0 0 1.000000 /end COMPU_METHOD
/begin COMPU_METHOD COMPU_METHOD_161 "Q = V/5.000000" RAT_FUNC "%0.6f" "hPa" COEFFS 0 1.000000 0.000000 0 0 5.000000 /end COMPU_METHOD
/begin COMPU_METHOD COMPU_METHOD_162 "Q = V*100.000000" RAT_FUNC "%0.6f" "%" COEFFS 0 100.000000 0.000000 0 0 1.000000 /end COMPU_METHOD
/begin COMPU_METHOD COMPU_METHOD_163 "Q = (V+40.000000)/1.000000" RAT_FUNC "%0.6f" "DegC" COEFFS 0 1.000000 40.000000 0 0 1.000000 /end COMPU_METHOD
/begin COMPU_METHOD COMPU_METHOD_164 "Q = V*3.276800" RAT_FUNC "%0.6f" "%/S" COEFFS 0 3.276800 0.000000 0 0 1.000000 /end COMPU_METHOD
/begin COMPU_METHOD COMPU_METHOD_165 "Q = V*335544.320000" RAT_FUNC "%0.6f" "%" COEFFS 0 335544.320000 0.000000 0 0 1.000000 /end COMPU_METHOD
/begin COMPU_METHOD COMPU_METHOD_166 "Q = V" RAT_FUNC "%0.6f" "DegC" COEFFS 0 1 0 0 0 1 /end COMPU_METHOD
/begin COMPU_METHOD COMPU_METHOD_167 "Q = V*655.360000" RAT_FUNC "%0.6f" "" COEFFS 0 655.360000 0.000000 0 0 1.000000 /end COMPU_METHOD
/begin COMPU_METHOD COMPU_METHOD_168 "Q = V*327.680000" RAT_FUNC "%0.6f" "" COEFFS 0 327.680000 0.000000 0 0 1.000000 /end COMPU_METHOD
/begin COMPU_METHOD COMPU_METHOD_169 "Q = V*25.600000" RAT_FUNC "%0.6f" "" COEFFS 0 25.600000 0.000000 0 0 1.000000 /end COMPU_METHOD
/begin COMPU_METHOD COMPU_METHOD_170 "Q = V*42.666667" RAT_FUNC "%0.6f" "" COEFFS 0 42.666667 0.000000 0 0 1.000000 /end COMPU_METHOD
/begin COMPU_METHOD COMPU_METHOD_171 "Q = V" RAT_FUNC "%0.6f" "ms" COEFFS 0 1.000000 0.000000 0 0 1.000000 /end COMPU_METHOD
/begin COMPU_METHOD COMPU_METHOD_172 "Q = V*100" RAT_FUNC "%0.6f" "Deg" COEFFS 0 100.000000 0.000000 0 0 1.000000 /end COMPU_METHOD
/begin COMPU_METHOD COMPU_METHOD_173 "Q = V*100" RAT_FUNC "%0.6f" "m/s2" COEFFS 0 100.000000 0.000000 0 0 1.000000 /end COMPU_METHOD
/end MODULE
/end PROJECT
/* (add any file trailer comments here) */
/* EOF Controller.a2l */
